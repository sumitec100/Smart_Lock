#include "BluetoothSerial.h"
#include "esp_gap_bt_api.h"
#include <Wire.h>
#include <Adafruit_GFX.h>
#include <Adafruit_SSD1306.h>

#define BLUE_LED 0
#define GREEN_LED 25
#define RED_LED 14

const int relay = 15;

#if !defined(CONFIG_BT_ENABLED) || !defined(CONFIG_BLUEDROID_ENABLED)
#error Bluetooth is not enabled! Please run `make menuconfig` to and enable it
#endif

BluetoothSerial SerialBT;

#define SCREEN_WIDTH 128
#define SCREEN_HEIGHT 64

Adafruit_SSD1306 display(SCREEN_WIDTH, SCREEN_HEIGHT, &Wire, -1);

static const uint8_t lock_screen_array[1024]={0xff, 0xff, 0xff, 0xff, 0xe0, 0x1f, 0xff, 0xff, 0xff, 0xff, 0xff, 0xff, 0xff, 0xff, 0xff, 0xff, 
0xff, 0xff, 0xff, 0xff, 0x00, 0x03, 0xff, 0xff, 0xff, 0xff, 0xff, 0xff, 0xff, 0xff, 0xff, 0xff, 
0xff, 0xff, 0xff, 0xfc, 0x00, 0x00, 0xff, 0xff, 0xff, 0xff, 0xff, 0xff, 0xff, 0xff, 0xff, 0xff, 
0xff, 0xff, 0xff, 0xf0, 0x00, 0x00, 0x7f, 0xff, 0xff, 0xff, 0xff, 0xff, 0xff, 0xff, 0xff, 0xff, 
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0xff, 0xff, 0xff, 0xff, 0xff, 0xff, 0xff, 0xff, 0xff, 0xff, 0xff, 0xff, 0xff, 0xff, 0xff, 0xff};

static const uint8_t unlock_screen_array[1024]={// 'UNLOCK', 128x64px
0xff, 0xff, 0xff, 0xff, 0xff, 0xff, 0xff, 0xff, 0xff, 0xff, 0xff, 0xff, 0xff, 0xff, 0xff, 0xff, 
0xff, 0xff, 0xff, 0xff, 0xff, 0xff, 0xff, 0xff, 0xff, 0xff, 0xff, 0xff, 0xff, 0xff, 0xff, 0xff, 
0xff, 0xff, 0xff, 0xff, 0xff, 0xff, 0xff, 0xff, 0xff, 0xff, 0xff, 0xff, 0xff, 0xff, 0xff, 0xff, 
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0xff, 0xff, 0xff, 0xff, 0xff, 0xff, 0xff, 0xff, 0xff, 0xff, 0xff, 0xff, 0xff, 0xff, 0xff, 0xff};

static const uint8_t main_image_array[1024]={// 'MainImage', 128x150px
// 'MainImage', 128x64px
0xff, 0xff, 0xff, 0xff, 0xff, 0xff, 0xff, 0xff, 0xff, 0xff, 0xff, 0xff, 0xff, 0xff, 0xff, 0xff, 
0xff, 0xff, 0xff, 0xff, 0xff, 0xff, 0xff, 0xff, 0xff, 0xff, 0xff, 0xff, 0xff, 0xff, 0xff, 0xff, 
0xff, 0xff, 0xff, 0xff, 0xff, 0xff, 0xff, 0xff, 0xff, 0xff, 0xff, 0xff, 0xff, 0xff, 0xff, 0xff, 
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0xff, 0xff, 0xff, 0xff, 0xff, 0xff, 0xff, 0xff, 0xff, 0xff, 0xff, 0xff, 0xff, 0xff, 0xff, 0xff};

void setup() {
  Serial.begin(115200);
  
  // Start I2C Communication SDA = 5 and SCL = 4 on Wemos Lolin32 ESP32 with built-in SSD1306 OLED
  Wire.begin(5, 4);

  if(!display.begin(SSD1306_SWITCHCAPVCC, 0x3C, false, false)) {
    Serial.println(F("SSD1306 allocation failed"));
    for(;;);
  }
  delay(2000); // Pause for 2 seconds
 
  // Clear the buffer.
  display.clearDisplay();
  
  // Draw bitmap on the screen
 display.drawBitmap(0, 0, main_image_array, 128, 64, 1);
  //display.drawBitmap(0, 0, unlock_screen_array, 128, 64, 1);
 display.display();


  
  pinMode(BLUE_LED,OUTPUT);
  pinMode(GREEN_LED,OUTPUT);
  pinMode(RED_LED,OUTPUT);
  pinMode(relay, OUTPUT);
  

  digitalWrite(RED_LED,HIGH);
  digitalWrite(BLUE_LED,LOW);
  digitalWrite(GREEN_LED,HIGH);
  
  digitalWrite(relay,LOW);
  //Serial.begin(115200);
  SerialBT.begin("ELock"); //Bluetooth device name
  esp_bt_pin_type_t pin_type = ESP_BT_PIN_TYPE_FIXED;
  esp_bt_pin_code_t pin_code;
  pin_code[0] = '2';
  pin_code[1] = '0';
  pin_code[2] = '2';
  pin_code[3] = '1';
  esp_bt_gap_set_pin(pin_type, 4, pin_code);
  Serial.println("The device started, now you can pair it with bluetooth!");
}

void loop() {
  int32_t val;
  char flag;
  char* pch=NULL;
  
  if (Serial.available()) {
    SerialBT.write(Serial.read());
  }
  if (SerialBT.available()) {
    flag = SerialBT.read();
    pch=strtok(&flag,"\r\n");
    
    if(*pch == '2'){       //UNLOCK
      Serial.write("GREEN ON");
      display.clearDisplay();
      display.drawBitmap(0, 0, unlock_screen_array, 128, 64, 1);
      display.display();
      digitalWrite(BLUE_LED,HIGH);
      digitalWrite(GREEN_LED,LOW);
      digitalWrite(RED_LED,HIGH);
      digitalWrite(relay, HIGH);
      SerialBT.write('U');
      SerialBT.write(13); 
      delay(10000); // 10secs interval 
      digitalWrite(relay, LOW);
      digitalWrite(RED_LED,LOW);
      digitalWrite(BLUE_LED,HIGH);
      digitalWrite(GREEN_LED,HIGH);
      display.clearDisplay();
      display.drawBitmap(0, 0, lock_screen_array, 128, 64, 1);
      display.display();
      SerialBT.write('L');
      SerialBT.write(13); 
      delay(50000); // 30secs interval 
     
    }
   else {
      
    }
    Serial.write(*pch);
    *pch=NULL;
  }
  delay(20);
}
